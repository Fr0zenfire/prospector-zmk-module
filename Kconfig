## Kconfig
```kconfig
choice PROSPECTOR_STATUS_SCREEN_LAYOUT
    prompt "Status screen layout"
    default PROSPECTOR_STATUS_SCREEN_CLASSIC

config PROSPECTOR_STATUS_SCREEN_CLASSIC
    bool "Classic layout"
    help
        Standard Prospector status screen

config PROSPECTOR_STATUS_SCREEN_RADII
    bool "Radii layout"
    help
        Colorful grid layout with rounded widgets

config PROSPECTOR_STATUS_SCREEN_FIELD
    bool "Field layout"
    help
        Minimal layout with flowing typing activity visualization

config PROSPECTOR_STATUS_SCREEN_OPERATOR
    bool "Operator layout"
    help
        Technical and information dense layout

endchoice

config PROSPECTOR_ROTATE_DISPLAY_180
    bool "Rotate the display 180 degrees"
    default n

config PROSPECTOR_SHOW_MODIFIERS
    bool "Display modifier key indicators (Cmd, Opt, Ctrl, Shift)"
    default y

config PROSPECTOR_SHOW_INACTIVE_MODIFIERS
    bool "Show inactive modifier indicators (dim when not pressed)"
    default y
    depends on PROSPECTOR_SHOW_MODIFIERS
    help
      When enabled, inactive modifiers are shown with a dim color.
      When disabled, inactive modifiers are hidden completely.
      Only affects classic and field layouts.

config PROSPECTOR_MODIFIER_ORDER
    string "Modifier display order"
    default "GACS"
    depends on PROSPECTOR_SHOW_MODIFIERS
    help
      Order of modifier indicators. Use exactly 4 characters:
      G=GUI/Cmd, A=Alt/Opt, C=Control, S=Shift.
      Each character must appear exactly once.

choice PROSPECTOR_MODIFIER_OS
    prompt "Modifier key style"
    default PROSPECTOR_MODIFIER_OS_MAC
    depends on PROSPECTOR_SHOW_MODIFIERS

config PROSPECTOR_MODIFIER_OS_GENERIC
    bool "Generic (CTRL, ALT, GUI, SHFT)"

config PROSPECTOR_MODIFIER_OS_WINDOWS
    bool "Windows"

config PROSPECTOR_MODIFIER_OS_MAC
    bool "Mac"

endchoice

choice PROSPECTOR_BRIGHTNESS_MODE
    prompt "Display brightness mode"
    default PROSPECTOR_BRIGHTNESS_AUTO

config PROSPECTOR_BRIGHTNESS_AUTO
    bool "Auto (ambient light sensor)"

config PROSPECTOR_BRIGHTNESS_FIXED
    bool "Fixed brightness"

config PROSPECTOR_BRIGHTNESS_MANUAL
    bool "Manual (keyboard-controlled)"

endchoice

config PROSPECTOR_FIXED_BRIGHTNESS
    int "Initial display brightness (1-100)"
    default 50
    range 1 100
    depends on !PROSPECTOR_BRIGHTNESS_AUTO

config PROSPECTOR_BRIGHTNESS_STEP
    int "Brightness adjustment step size"
    default 10
    range 1 50
    depends on PROSPECTOR_BRIGHTNESS_MANUAL

config PROSPECTOR_LAYER_NAME_UPPERCASE
    bool "Display layer names in uppercase"
    default y
    help
      When enabled, layer names will be converted to uppercase for display.

config PROSPECTOR_DISPLAY_SLEEP_ENABLE
    bool "Turn off display on idle"
    default n

config PROSPECTOR_DISPLAY_IDLE_TIMEOUT_MS
    int "Display idle timeout in ms"
    default 30000
    depends on PROSPECTOR_DISPLAY_SLEEP_ENABLE

config PROSPECTOR_DISPLAY_SLEEP_USE_PM
    bool "Use Zephyr PM to suspend the display (SLEEP_IN)"
    default n
    depends on PROSPECTOR_DISPLAY_SLEEP_ENABLE && PM_DEVICE

config PROSPECTOR_FPS_MONITOR
    bool "Show real-time FPS diagnostic counter on screen"
    default n
    help
      When enabled, displays a real-time hardware FPS counter on the status screen.
```

## boards/shields/prospector_adapter/src/layouts/track/Kconfig.defconfig
```kconfig
if PROSPECTOR_STATUS_SCREEN_TRACK

config ZMK_DISPLAY_STATUS_SCREEN_CUSTOM
    select LV_USE_LABEL
    select LV_USE_FLEX
    select LV_USE_ARC
    select LV_USE_BAR
    select LV_COLOR_SCREEN_TRANSP
    select LV_FONT_MONTSERRAT_12

config ZMK_WPM
    default y

config LV_Z_MEM_POOL_SIZE
    default 28672

endif
```
